## main/Kconfig.projbuild
```kconfig
menu "INVERNADERO CONFIG"

    config ESP_WIFI_SSID
        string "WiFi SSID"
        default "myssid"
        help
            SSID (network name) for the example to connect to.

    config ESP_WIFI_PASSWORD
        string "WiFi Password"
        default "mypassword"
        help
            WiFi password (WPA or WPA2) for the example to use.

    config ESP_MAXIMUM_RETRY
        int "Intentos de reconectar a wifi"
        default 5
        help
            Set the Maximum retry to avoid station reconnecting to the AP unlimited when the AP is really inexistent.


    config i2c_luz_sda
        int "gpio pin: sda"
        default 15
        help
            el numero del gpio

    config i2c_luz_scl
        int "gpio pin: scl"
        default 2
        help
            el numero de gpio

endmenu
```
